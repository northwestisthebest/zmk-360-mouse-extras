## Kconfig
```kconfig
config ZMK_LED_INDICATOR
    bool "Binary LED indicator (layer state + pointer activity)"
    depends on DT_HAS_ZMK_LED_INDICATOR_ENABLED
    default y
    select GPIO
    select INPUT

if ZMK_LED_INDICATOR

module = ZMK_LED_INDICATOR
module-str = ZMK_LED_INDICATOR
source "${ZEPHYR_BASE}/subsys/logging/Kconfig.template.log_config"

endif # ZMK_LED_INDICATOR

config ZMK_BEHAVIOR_MOUSE_TOGGLE
    bool "Mouse button toggle behavior (&mtog)"
    depends on DT_HAS_ZMK_BEHAVIOR_MOUSE_TOGGLE_ENABLED
    default y
    select INPUT

config ZMK_MOUSE_BUTTON_WATCHDOG
    bool "Release mouse buttons left stuck after all switches are up"
    depends on ZMK_POINTING
    default y if ZMK_LED_INDICATOR
```

## dts/bindings/zmk,behavior-mouse-toggle.yaml
```yaml
# SPDX-License-Identifier: MIT
description: |
  Mouse button toggle: each press flips the given button(s) between held and
  released. While held, normal clicks of the same button are absorbed;
  only another &mtog press releases it.

compatible: "zmk,behavior-mouse-toggle"

include: one_param.yaml
```

## dts/bindings/zmk,input-processor-ble-throttle.yaml
```yaml
# SPDX-License-Identifier: MIT
description: |
  Limits pointer/scroll reports to one per period while output is Bluetooth.
  Motion is merged, not dropped. No effect over USB. Buttons are never delayed.

compatible: "zmk,input-processor-ble-throttle"

include: ip_zero_param.yaml

properties:
  period-ms:
    type: int
    default: 8
    description: Minimum time between reports over BLE (8 ms = 125 reports/s).
```

## dts/bindings/zmk,led-indicator.yaml
```yaml
# SPDX-License-Identifier: MIT
description: |
  Binary LED indicator driven by ZMK layer state and pointing-device activity.

compatible: "zmk,led-indicator"

properties:
  gpios:
    type: phandle-array
    required: true
    description: The GPIO driving the LED. Use GPIO_ACTIVE_LOW if the LED sinks.

  indicate-layer:
    type: int
    default: 1
    description: Layer whose activation lights the LED.

  activity-device:
    type: phandle
    description: |
      Pointing device to watch for movement. Omit to disable activity blinking.

  activity-hold-ms:
    type: int
    default: 60
    description: How long the LED stays lit after the last motion report.

  blink-layers:
    type: array
    description: |
      Mode layers announced by blinking. Entering the first listed layer blinks
      twice, the second three times, and so on; leaving any of them blinks once.
```
